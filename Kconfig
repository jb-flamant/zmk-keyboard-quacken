## Kconfig
```kconfig
config ZMK_BEHAVIOR_MOD_HOLD
  bool
  default y
    
config ZMK_BEHAVIOR_DEAD_KEY
  bool
  default y
  depends on DT_HAS_ZMK_BEHAVIOR_DEAD_KEY_ENABLED

config INPUT_TRACKBALL_I2C
  bool
  default y
  depends on DT_HAS_JBFLAMANT_TRACKBALL_I2C_ENABLED
  depends on INPUT
  select I2C

config QUACKEN_KSCAN_GPIO_DIRECT_RESILIENT
  bool
  default y
  depends on DT_HAS_QUACKEN_KSCAN_GPIO_DIRECT_RESILIENT_ENABLED
  depends on KSCAN
  select ZMK_KSCAN_GPIO_DRIVER
```

## dts/bindings/input/jbflamant,trackball-i2c.yaml
```yaml
description: |
  I2C Trackball

  Trackball exposed as an I2C target (jb-flamant/trackball, branch
  feat/i2c-target), polled by the keyboard. Reports relative motion
  (INPUT_REL_X/Y) and buttons (INPUT_BTN_0..2) to be consumed by a
  `zmk,input-listener`.

compatible: "jbflamant,trackball-i2c"

include: i2c-device.yaml

properties:
  poll-period-ms:
    type: int
    default: 10
    description: Polling period of the trackball registers, in milliseconds.
  absent-poll-period-ms:
    type: int
    default: 1000
    description: |
      Polling period, in milliseconds, once the trackball has stopped answering
      (unplugged). The bus is shared with the right-half IO expander, so failed
      reads are kept rare; normal polling resumes as soon as it answers again.
```

## dts/bindings/kscan/quacken,kscan-gpio-direct-resilient.yaml
```yaml
# Copyright (c) 2020, Pete Johanson (zmk,kscan-gpio-direct)
# SPDX-License-Identifier: MIT

description: |
  Direct GPIO keyboard KSCAN controller, resilient to read errors.

  Same as `zmk,kscan-gpio-direct`, but a failed read (e.g. an I2C error on an
  IO expander) is retried on the next scan period instead of stopping the scan.

compatible: "quacken,kscan-gpio-direct-resilient"

include: kscan.yaml

properties:
  input-gpios:
    type: phandle-array
    required: false
  input-keys:
    type: phandles
    required: false
    description: List of gpio-key references
  debounce-period:
    type: int
    required: false
    deprecated: true
    description: Deprecated. Use debounce-press-ms and debounce-release-ms instead.
  debounce-press-ms:
    type: int
    default: 5
    description: Debounce time for key press in milliseconds. Use 0 for eager debouncing.
  debounce-release-ms:
    type: int
    default: 5
    description: Debounce time for key release in milliseconds.
  debounce-scan-period-ms:
    type: int
    default: 1
    description: Time between reads in milliseconds when any key is pressed.
  poll-period-ms:
    type: int
    default: 10
    description: Time between reads in milliseconds when no key is pressed and ZMK_KSCAN_DIRECT_POLLING is enabled.
  toggle-mode:
    type: boolean
    description: Enable toggle-switch mode.
```
